## kbuild_skeleton/student_information_darwin/Kconfig
```kconfig
config LNX500_TEST
	bool "Enable LNX500 c script"
	default n
	help
		This is for the LNX500 Lab test.
```

## test/student_information_darwin/Kconfig
```kconfig
config LNX500_TEST
	bool "LNX500 Test configuration"
	default n
	help
	  LNX500 Test config
```
